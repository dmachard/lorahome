extern uint8_t gw_lora_chip;
PhysicalLayer* radio = nullptr;
volatile bool rxFlag = false;
void IRAM_ATTR onReceive() { rxFlag = true; }

bool gcm_decrypt(const uint8_t *frame, uint8_t frame_len, uint8_t *payload,
                 uint8_t payload_size) {
  if (frame_len < HDR_SIZE + TAG_SIZE)
    return false;
  uint8_t payload_len = frame_len - HDR_SIZE - TAG_SIZE;
  if (payload_len > payload_size)
    return false;

  uint8_t iv[12] = {0};
  memcpy(iv, frame, 9);

  const uint8_t *ciphertext = frame + HDR_SIZE;
  const uint8_t *tag = frame + frame_len - TAG_SIZE;

  gcm.clear();
  gcm.setKey(AES_KEY, 16);
  gcm.setIV(iv, 12);
  gcm.addAuthData(frame, HDR_SIZE);
  gcm.decrypt(payload, ciphertext, payload_len);

  uint8_t computed_tag[TAG_SIZE];
  gcm.computeTag(computed_tag, TAG_SIZE);
  return memcmp(computed_tag, tag, TAG_SIZE) == 0;
}

void processLoRaPacket() {
  rxFlag = false;
  global_rx_interrupts++;
  uint8_t frame[128];
  int state = radio->readData(frame, sizeof(frame));
  int len = radio->getPacketLength();

  if (state != RADIOLIB_ERR_NONE) {
    global_malformed_packets++;
    radio->startReceive();
    return;
  }

  if (len < HDR_SIZE + TAG_SIZE) {
    global_malformed_packets++;
    Serial.printf("Packet too short: %d bytes\n", len);
    radio->startReceive();
    return;
  }

  uint8_t node_id = frame[0];
  if (node_id >= MAX_NODES) {
    global_unknown_nodes++;
    Serial.printf("Node %d | UNKNOWN NODE\n", node_id);
    radio->startReceive();
    return;
  }

  uint8_t payload_len = len - HDR_SIZE - TAG_SIZE;
  uint8_t payload[128] = {0};

  if (payload_len > sizeof(payload)) {
    global_malformed_packets++;
    Serial.printf("Node %d | Packet too large (%d bytes)\n", node_id, len);
    radio->startReceive();
    return;
  }

  NodeData &n = nodes[node_id];
  if (!gcm_decrypt(frame, len, payload, sizeof(payload))) {
    n.auth_failures++;
    Serial.printf("Node %d | AUTH FAILED\n", node_id);
    radio->startReceive();
    return;
  }

  uint32_t seq = ((uint32_t)frame[1] << 24) | ((uint32_t)frame[2] << 16) |
                 ((uint32_t)frame[3] << 8) | ((uint32_t)frame[4]);
  uint32_t random_id = ((uint32_t)frame[5] << 24) | ((uint32_t)frame[6] << 16) |
                        ((uint32_t)frame[7] << 8) | ((uint32_t)frame[8]);
  uint8_t current_reset_reason = 0;
  uint8_t current_error_code = 0;

  bool is_sensor_payload = (payload_len >= sizeof(SensorPayload));
  SensorPayload sp;
  memset(&sp, 0, sizeof(sp));

  if (is_sensor_payload) {
    memcpy(&sp, payload, sizeof(SensorPayload));
    current_reset_reason = sp.reset_reason;
    current_error_code = sp.error_code;
  }

  if (n.seen) {
    if (random_id != n.last_random_id) {
      // Node rebooted (new random session ID generated by node TRNG)
      Serial.printf("Node %d | NEW REBOOT SESSION DETECTED (random_id: %08X -> %08X, reason: %d)\n",
                    node_id, n.last_random_id, random_id, current_reset_reason);
      n.reboots++;
    } else if (seq < n.seq) {
      Serial.printf("Node %d | WARNING: UNEXPECTED SEQ ROLLBACK (seq %lu < %lu)\n", node_id, seq, n.seq);
      n.reboots++;
    } else if (seq == n.seq) {
      // Duplicate packet within the same boot session -> ignore
      radio->startReceive();
      return;
    } else if (seq > n.seq + 1) {
      uint32_t lost = seq - (n.seq + 1);
      n.packets_lost += lost;
      Serial.printf("Node %d | PACKET LOSS DETECTED: %lu packet(s) lost (seq %lu -> %lu)\n", node_id, lost, n.seq, seq);
    }
  }

  n.seen = true;
  n.seq = seq;
  n.last_random_id = random_id;
  n.rssi = radio->getRSSI();
  n.snr = radio->getSNR();
  n.last_seen_ms = millis();
  n.packets_count++;
  n.last_reset_reason = current_reset_reason;
  n.last_error_code = current_error_code;

  if (is_sensor_payload) {
    n.tx_interval = sp.tx_interval;
    memset(n.name, 0, sizeof(n.name));
    strncpy(n.name, sp.name, sizeof(n.name) - 1);

    n.readings_count = min((int)sp.count, 10);
    memcpy(n.readings, sp.readings, n.readings_count * sizeof(SensorReading));
  } else {
    n.readings_count = 0;
    Serial.printf("Node %d | Payload ignored due to unexpected size: received=%d bytes\n", node_id, payload_len);
  }

  last_active_node_id = node_id;
  updateDisplay();
  radio->startReceive();
}

void initLoRa() {
  if (oled_initialized) {
    display.println("Init LoRa Radio...");
    display.display();
  }

  SPI.begin(SPI_SCK, SPI_MISO, SPI_MOSI);

  int state = RADIOLIB_ERR_UNKNOWN;

  if (gw_lora_chip == 2) {
    Serial.println("Initializing Gateway Radio: SX1262...");
    Module* mod = new Module(LORA_CS, LORA_DIO1, LORA_RST, LORA_BUSY);
    SX1262* radio62 = new SX1262(mod);
    state = radio62->begin(LORA_FREQ, LORA_BW, LORA_SF, LORA_CR, RADIOLIB_SX126X_SYNC_WORD_PRIVATE,
                           LORA_POWER, LORA_PREAMBLE);
    if (state == RADIOLIB_ERR_NONE) {
      radio = radio62;
    }
  } else {
    Serial.println("Initializing Gateway Radio: SX1278...");
    Module* mod = new Module(LORA_CS, LORA_DIO0, LORA_RST, -1);
    SX1278* radio78 = new SX1278(mod);
    state = radio78->begin(LORA_FREQ, LORA_BW, LORA_SF, LORA_CR, 0x12,
                           LORA_POWER, LORA_PREAMBLE);
    if (state == RADIOLIB_ERR_NONE) {
      radio = radio78;
    }
  }

  if (state != RADIOLIB_ERR_NONE || radio == nullptr) {
    Serial.printf("LoRa Radio Init failed: %d\n", state);
    if (oled_initialized) {
      display.println("LoRa Radio: FAILED!");
      display.printf("Error code: %d\n", state);
      display.display();
    }
    while (true)
      delay(1000);
  }

  if (oled_initialized) {
    display.println("LoRa Radio: OK");
    display.display();
  }

  radio->setPacketReceivedAction(onReceive);
  radio->startReceive();
}
